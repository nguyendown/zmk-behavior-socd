#include <dt-bindings/zmk/keys.h>
#include <behaviors.dtsi>
#include <dt-bindings/zmk/kscan_mock.h>
#include "../behavior_keymap.dtsi"

/* Basic SOCD test with FIP. */

&socd {
    first-input-priority;
};

&kscan {
    events = <
        // Press &socd A
        ZMK_MOCK_PRESS(0,0,10)
        // Tap &socd D
        ZMK_MOCK_PRESS(1,0,10)
        ZMK_MOCK_RELEASE(1,0,10)
        ZMK_MOCK_RELEASE(0,0,10)
    >;
};
