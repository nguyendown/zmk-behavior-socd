## Kconfig
```kconfig
# Copyright (c) 2023 The ZMK Contributors
# SPDX-License-Identifier: MIT

config ZMK_BEHAVIOR_SOCD
    bool
    default y
    depends on DT_HAS_ZMK_BEHAVIOR_SOCD_ENABLED
```

## dts/bindings/zmk,behavior-socd.yaml
```yaml
# Copyright (c) 2024 The ZMK Contributors
# SPDX-License-Identifier: MIT

description: SOCD behavior

compatible: "zmk,behavior-socd"

include: one_param.yaml

properties:
  bindings:
    type: phandles
    required: true
  no-resume:
    type: boolean
  neutral:
    type: boolean
  first-input-priority:
    type: boolean
  absolute-priority:
    type: int
```
